## boards/shields/MacroPad2x5/Kconfig.shield
```kconfig
# Copyright (c) 2020 The ZMK Contributors
# SPDX-License-Identifier: MIT

config SHIELD_MACROPAD2X5
    def_bool $(shields_list_contains,MacroPad2x5)
```
